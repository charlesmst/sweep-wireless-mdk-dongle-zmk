## config/boards/shields/sweep/Kconfig.defconfig
```kconfig
# Copyright (c) 2020 The ZMK Contributors
# SPDX-License-Identifier: MIT

if SHIELD_SWEEP_DONGLE || SHIELD_SWEEP_LEFT_CENTRAL

config ZMK_KEYBOARD_NAME
	default "Sweep"
	
config ZMK_SPLIT_BLE_ROLE_CENTRAL
	default y
	
config ZMK_USB
	default y

endif

if SHIELD_SWEEP_LEFT || SHIELD_SWEEP_RIGHT || SHIELD_SWEEP_DONGLE 

config ZMK_SPLIT
	default y

config ZMK_BLE
	default y
	
endif


if SHIELD_DONGLE_SETTINGS_RESET

config ZMK_KEYBOARD_NAME
	default "SETTINGS RESET"

endif
```

## config/boards/shields/sweep/Kconfig.shield
```kconfig
# Copyright (c) 2020 The ZMK Contributors
# SPDX-License-Identifier: MIT

config SHIELD_SWEEP_LEFT
	def_bool $(shields_list_contains,sweep_left)

config SHIELD_SWEEP_LEFT_CENTRAL
	def_bool $(shields_list_contains,sweep_left_central)

config SHIELD_SWEEP_RIGHT
	def_bool $(shields_list_contains,sweep_right)

config SHIELD_SWEEP_DONGLE
	def_bool $(shields_list_contains,sweep_dongle)

config SHIELD_DONGLE_SETTINGS_RESET
	def_bool $(shields_list_contains,dongle_reset)
```
